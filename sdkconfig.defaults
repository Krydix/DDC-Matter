## sdkconfig.defaults
```kconfig
CONFIG_PARTITION_TABLE_CUSTOM=y
CONFIG_PARTITION_TABLE_CUSTOM_FILENAME="partitions.csv"
CONFIG_PARTITION_TABLE_FILENAME="partitions.csv"
CONFIG_ESPTOOLPY_FLASHSIZE_4MB=y
CONFIG_COMPILER_CXX_EXCEPTIONS=y
CONFIG_COMPILER_CXX_EXCEPTIONS_EMG_POOL_SIZE=4096
CONFIG_BT_ENABLED=y
CONFIG_BLE_MESH=n
CONFIG_ENABLE_CHIPOBLE=y
CONFIG_CHIPOBLE_ENABLE_ADVERTISING_AUTOSTART=1
CONFIG_OPENTHREAD_ENABLED=n
CONFIG_CUSTOM_DEVICE_INFO_PROVIDER=y
CONFIG_LWIP_LOCAL_HOSTNAME="display-switcher"
CONFIG_USE_MINIMAL_MDNS=n
CONFIG_MBEDTLS_HKDF_C=y
CONFIG_MBEDTLS_CERTIFICATE_BUNDLE=y
CONFIG_MBEDTLS_CERTIFICATE_BUNDLE_DEFAULT_FULL=y
```
